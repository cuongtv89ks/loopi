## os/Config.in
```kconfig
menu "Loopi"
	source "$BR2_EXTERNAL_LOOPI_PATH/package/loopi-agent/Config.in"
endmenu
```

## os/package/loopi-agent/Config.in
```kconfig
config BR2_PACKAGE_LOOPI_AGENT
	bool "loopi-agent"
	depends on BR2_PACKAGE_HOST_RUSTC_TARGET_ARCH_SUPPORTS
	select BR2_PACKAGE_HOST_RUSTC
	select BR2_PACKAGE_ALSA_LIB
	select BR2_PACKAGE_OPUS
	help
	  Loopi capture agent: records video and audio and uploads
	  them to the Loopi brain.
```
